#include "config.h"
#include "led.h"

void  delay_ms(unsigned int ms);
void init();
void self_check();
void rounddisplay();
void chardisplay();
void picdisplay();

unsigned char Pone[DEGREE_DIVMAX]={0x00,0x00,0xFC,0x24,0xE4,0x04,0x3F,0xC4,0x05,0xF6,0x04,0x04,
																	0x00,0x1E,0xC0,0x40,0x7F,0x50,0x56,0x4A,0x4A,0xD6,0x10,0x00,
																	0x20,0x18,0x29,0x2E,0x28,0xA9,0xAE,0x68,0x2C,0x0B,0x98,0x08,
																	0xFE,0x02,0x1A,0xE6,0x48,0x54,0xD4,0x55,0xD6,0x54,0x54,0x4C};
unsigned char Ptwo[DEGREE_DIVMAX]={0x08,0x06,0x01,0x02,0x0B,0x08,0x04,0x02,0x03,0x04,0x08,0x0F,
																	0x08,0x08,0x0B,0x04,0x04,0x03,0x04,0x04,0x04,0x0B,0x08,0x00,
																	0x01,0x01,0x01,0x01,0x05,0x09,0x0F,0x01,0x01,0x01,0x01,0x01,
																	0x0F,0x01,0x02,0x09,0x08,0x04,0x03,0x00,0x07,0x08,0x08,0x0E};
unsigned char Pone_pic[DEGREE_DIVMAX]={0xff,0xff,0xff,0x7f,0x3f,0x3f,0x1f,0x1f,0x1f,0x3f,0x3f,0x7f,
																	0x7f,0xff,0xff,0xff,0x3f,0x1f,0x0f,0x07,0x01,0x00,0x01,0x03,
																	0x07,0x07,0x0f,0x1f,0xff,0x1f,0x0f,0x07,0x07,0x03,0x01,0x00,
																	0x01,0x07,0x0f,0x1f,0x3f,0xff,0xff,0xff,0x7f,0x7f,0x3f,0x3f,
																	0x1f,0x1f,0x1f,0x3f,0x3f,0x7f,0xff,0xff};
unsigned char Ptwo_pic[DEGREE_DIVMAX]={0xff,0x00,0x00,0x00,0x00,0x00,0x00,0x00,0x00,0x00,0x00,0x00,
																	0x00,0x00,0xff,0x00,0x00,0x00,0x00,0x00,0x00,0x00,0x00,0x00,
																	0x00,0x00,0x00,0x00,0xff,0x00,0x00,0x00,0x00,0x00,0x00,0x00,
																	0x00,0x00,0x00,0x00,0x00,0x00,0xff,0x00,0x00,0x00,0x00,0x00,
																	0x00,0x00,0x00,0x00,0x00,0x00,0x00,0xff};
//void test(){while(1){ledr_on();P10=LOCASIGNAL;P11=KEY;}}
void main(){
	init();	
	self_check();
	
	while(KEY==T_OFF);
	motor_on();
	while(spd_t>SPD_TWORK);
	rounddisplay();
	
	if(P31) chardisplay();
	else picdisplay();
	
	motor_off();
	while(1);
}

void exint0() interrupt 0       //INT0@LOCASIGNAL
{
	if(time_ov) {time_ov=0;spd_t=0xff;}
	else spd_t=time;
	time=0;
}
void tm0_isr() interrupt 1 using 1       /* Timer0 interrupt routine */
{
	time++;	
	if(time==0xff) time_ov=1;
}

void init(){
	unsigned char i;
	P1=P2=P3=0xff;
	//int0 init
  INT0 = 1;										//setbit P32
  IT0 = 1;                    //INT0.set to down lip
  EX0 = 1;                    //INT0.enable
  EA = 1;
	//t0 init
  AUXR &= 0x7f;                   //set t0 to mode12T
  TMOD = 0x00;                    //set t0 to mode0
  TL0 = T1MS;                     //time register init
  TH0 = T1MS >> 8;
  TR0 = 1;                        //start t0
  ET0 = 1;                        //t0 int enable
  //EA = 1;

	for(i=0;i<=DEGREE_DIVMAX;i++){
		Pone[i]=~Pone[i];
		Ptwo[i]=~Ptwo[i];
	}
}

void self_check(){
	unsigned char i;
	ledr_on();
	P10=0;
	for(i=8;i;i--){
		delay_ms(1000);
		P1 <<=1;
		P1++;
		rgbrr();
	}
	P20=0;
	for(i=8;i;i--){
		delay_ms(1000);
		P2 <<=1;
		P2++;
		rgbrr();
	}	
	P3 |= 0x70; //ledrgb_off();
}

void rounddisplay(){
	unsigned char i;
	ledr_on();
	P10=0;
	for(i=8;i;i--){
		delay_ms(500);
		P1 <<=1;
		P1++;
	}
	P20=0;
	for(i=8;i;i--){
		delay_ms(500);
		P2 <<=1;
		P2++;
	}
	delay_ms(500);
	P27=0;
	for(i=8;i;i--){
		delay_ms(500);
		P2 >>=1;
		P2|=0x80;
	}
	P17=0;
	for(i=8;i;i--){
		delay_ms(500);
		P1 >>=1;
		P1|=0x80;
	}
	ledr_off();	
}

void chardisplay(){
	unsigned char i;
	delay_ms(1000);
	while(spd_t>SPD_TWORKC);
	ledr_on();
	while(KEY==T_OFF){
		while(LOCASIGNAL==LOCA_OFF);
		for(i=0;i<DEGREE_DIVMAX;i++){
			P1=Pone[i];
			P2=Ptwo[i];
			delay_ms(spd_t*(14.0/DEGREE_DIVMAX));//(14.0ms<20ms)
		}
		P1=0xff;
		P2=0xff;
	}	
}
void picdisplay(){
	unsigned char i;
	delay_ms(1000);
	while(spd_t>SPD_TWORKC);
	while(KEY==T_OFF){
		while(LOCASIGNAL==LOCA_OFF);
		ledr_on();
		for(i=0;i<DEGREE_DIVMAX-1;i++){
			if(i==DEGREE_DIVMAX/4){ledr_off();ledg_on();}
			if(i==DEGREE_DIVMAX/2) ledr_on();
			if(i==DEGREE_DIVMAX*3/4){ledr_off();ledg_off();ledb_on();}
			P1=Pone_pic[i];
			P2=Ptwo_pic[i];
			delay_ms(spd_t*(19.0/DEGREE_DIVMAX));//(19.0ms<20ms)
		}
		ledb_off();
		P1=0xff;
		P2=0xff;
	}	
}

void delay_ms(unsigned int ms){
     unsigned int i;
	 do{
	      i = MAIN_Fosc / 13000;
		  while(--i)	;   //14T per loop
     }while(--ms);
}

